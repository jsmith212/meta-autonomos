## meta-autonomos-core/conf/distro/autonomos.conf
```bitbake
# Start with a base Poky distro and go from there
require conf/distro/poky.conf

DISTRO = "autonomos"
DISTRO_NAME = "AutonomOS"
DISTRO_VERSION = "0.1"
DISTRO_CODENAME = "Rubik"

# Use systemd over sysvinit
DISTRO_FEATURES:append = " systemd"
DISTRO_FEATURES_BACKFILL_CONSIDERED += "sysvinit"
VIRTUAL-RUNTIME_init_manager = "systemd"
VIRTUAL-RUNTIME_initscripts = "systemd-compat-units"
VIRTUAL-RUNTIME_network_manager = "networkd"

# Strip out unnecessary graphical support
DISTRO_FEATURES:remove = " x11 wayland"

# Use IPK package format
PACKAGE_CLASSES = "package_ipk"

# Require wifi
DISTRO_FEATURES:append = " wifi bluetooth"

# Support containerization
DISTRO_FEATURES:append = "${@bb.utils.contains('AUTONOMOS_FEATURES', 'containers', ' virtualization', '', d)}"
DISTRO_FEATURES:append = "${@bb.utils.contains('AUTONOMOS_FEATURES', 'kubernetes', ' k3s seccomp virtualization', '', d)}"

# Fix the command line if kubernetes is enabled
CMDLINE_ROOTFS:append = "${@bb.utils.contains('AUTONOMOS_FEATURES', 'kubernetes', ' cgroup_enable=cpuset cgroup_memory=1 cgroup_enable=memory ', '', d)}"

# Add mender support
INHERIT += "mender-full"

# Set the C standard library to use
TCLIBC = "glibc"
```

## meta-autonomos-core/conf/layer.conf
```bitbake
# We have a conf and classes directory, add to BBPATH
BBPATH .= ":${LAYERDIR}"

# We have recipes-* directories, add to BBFILES
BBFILES += "${LAYERDIR}/recipes-*/*/*.bb \
            ${LAYERDIR}/recipes-*/*/*.bbappend"

BBFILE_COLLECTIONS += "autonomos-core"
BBFILE_PATTERN_autonomos-core = "^${LAYERDIR}/"
BBFILE_PRIORITY_autonomos-core = "6"

LAYERDEPENDS_autonomos-core = " \
    core"

LAYERSERIES_COMPAT_autonomos-core = "scarthgap"
```
